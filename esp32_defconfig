## esp32_defconfig
```kconfig
# M5Stack Cardputer defconfig

# Enable basic system configuration
CONFIG_SYS_CLOCK_HW_CYCLES_PER_SEC=240000000
CONFIG_SYS_CLOCK_TICKS_PER_SEC=100

# Enable UART console
CONFIG_UART_CONSOLE=y
CONFIG_UART_CONSOLE_ON_DEV_NAME="UART_0"

# Enable SPI flash
CONFIG_SPI=y
CONFIG_SPI_1=y
CONFIG_SPI_1_NAME="SPI_1"
CONFIG_SPI_1_CS_GPIO_PIN=5
CONFIG_SPI_1_MISO_GPIO_PIN=19
CONFIG_SPI_1_MOSI_GPIO_PIN=23
CONFIG_SPI_1_SCK_GPIO_PIN=18

# Enable I2C
CONFIG_I2C=y
CONFIG_I2C_0=y
CONFIG_I2C_0_NAME="I2C_0"
CONFIG_I2C_0_SCL_GPIO_PIN=22
CONFIG_I2C_0_SDA_GPIO_PIN=21

# Enable GPIO
CONFIG_GPIO=y
CONFIG_GPIO_0=y
CONFIG_GPIO_0_NAME="GPIO_0"
CONFIG_GPIO_0_PIN_0=32
CONFIG_GPIO_0_PIN_1=33
CONFIG_GPIO_0_PIN_2=34
CONFIG_GPIO_0_PIN_3=35

# Enable ADC
CONFIG_ADC=y
CONFIG_ADC_0=y
CONFIG_ADC_0_NAME="ADC_0"
CONFIG_ADC_0_INPUT_PIN=36

# Enable PWM
CONFIG_PWM=y
CONFIG_PWM_0=y
CONFIG_PWM_0_NAME="PWM_0"
CONFIG_PWM_0_PIN=25

# Enable I2S
CONFIG_I2S=y
CONFIG_I2S_0=y
CONFIG_I2S_0_NAME="I2S_0"
CONFIG_I2S_0_BCLK_GPIO_PIN=26
CONFIG_I2S_0_LRCK_GPIO_PIN=27
CONFIG_I2S_0_DATA_GPIO_PIN=32

# Enable SD card
CONFIG_SDMMC=y
CONFIG_SDMMC_0=y
CONFIG_SDMMC_0_NAME="SDMMC_0"
CONFIG_SDMMC_0_CD_GPIO_PIN=4
CONFIG_SDMMC_0_CLK_GPIO_PIN=14
CONFIG_SDMMC_0_CMD_GPIO_PIN=15
CONFIG_SDMMC_0_DATA_0_GPIO_PIN=2
CONFIG_SDMMC_0_DATA_1_GPIO_PIN=12
CONFIG_SDMMC_0_DATA_2_GPIO_PIN=13
CONFIG_SDMMC_0_DATA_3_GPIO_PIN=26

# Enable WiFi
CONFIG_WIFI=y
CONFIG_WIFI_ESP_WIFI=y
CONFIG_WIFI_ESP_WIFI_SPI=y
CONFIG_WIFI_ESP_WIFI_SPI_CS_GPIO_PIN=5
CONFIG_WIFI_ESP_WIFI_SPI_MISO_GPIO_PIN=19
CONFIG_WIFI_ESP_WIFI_SPI_MOSI_GPIO_PIN=23
CONFIG_WIFI_ESP_WIFI_SPI_SCK_GPIO_PIN=18

# Enable Bluetooth
CONFIG_BT=y
CONFIG_BT_ESP32=y

# Enable File System
CONFIG_FS=y
CONFIG_FS_FAT=y

# Enable Networking
CONFIG_NET=y
CONFIG_NET_L2_ETHERNET=y
CONFIG_NET_L2_ETHERNET_0=y
CONFIG_NET_L2_ETHERNET_0_NAME="ETH_0"
CONFIG_NET_L2_ETHERNET_0_MAC_ADDRESS="00:11:22:33:44:55"

# Enable USB
CONFIG_USB=y
CONFIG_USB_CDC_ACM=y
CONFIG_USB_CDC_ACM_0=y
CONFIG_USB_CDC_ACM_0_NAME="CDC_ACM_0"
CONFIG_USB_CDC_ACM_0_VENDOR_ID="0x1234"
CONFIG_USB_CDC_ACM_0_PRODUCT_ID="0x5678"

# Enable Display
CONFIG_DISPLAY=y
CONFIG_DISPLAY_ILI9341=y
CONFIG_DISPLAY_ILI9341_SPI=y
CONFIG_DISPLAY_ILI9341_SPI_CS_GPIO_PIN=5
CONFIG_DISPLAY_ILI9341_SPI_MISO_GPIO_PIN=19
CONFIG_DISPLAY_ILI9341_SPI_MOSI_GPIO_PIN=23
CONFIG_DISPLAY_ILI9341_SPI_SCK_GPIO_PIN=18
CONFIG_DISPLAY_ILI9341_RST_GPIO_PIN=4
CONFIG_DISPLAY_ILI9341_DC_GPIO_PIN=2

# Enable Touchscreen
CONFIG_TOUCHSCREEN=y
CONFIG_TOUCHSCREEN_XPT2046=y
CONFIG_TOUCHSCREEN_XPT2046_SPI=y
CONFIG_TOUCHSCREEN_XPT2046_SPI_CS_GPIO_PIN=5
CONFIG_TOUCHSCREEN_XPT2046_SPI_MISO_GPIO_PIN=19
CONFIG_TOUCHSCREEN_XPT2046_SPI_MOSI_GPIO_PIN=23
CONFIG_TOUCHSCREEN_XPT2046_SPI_SCK_GPIO_PIN=18
CONFIG_TOUCHSCREEN_XPT2046_IRQ_GPIO_PIN=25

# Enable Camera
CONFIG_CAMERA=y
CONFIG_CAMERA_OV2640=y
CONFIG_CAMERA_OV2640_I2C=y
CONFIG_CAMERA_OV2640_I2C_NAME="I2C_0"
CONFIG_CAMERA_OV2640_I2C_SCL_GPIO_PIN=22
CONFIG_CAMERA_OV2640_I2C_SDA_GPIO_PIN=21
CONFIG_CAMERA_OV2640_D0_GPIO_PIN=32
CONFIG_CAMERA_OV2640_D1_GPIO_PIN=35
CONFIG_CAMERA_OV2640_D2_GPIO_PIN=34
CONFIG_CAMERA_OV2640_D3_GPIO_PIN=5
CONFIG_CAMERA_OV2640_D4_GPIO_PIN=39
CONFIG_CAMERA_OV2640_D5_GPIO_PIN=18
CONFIG_CAMERA_OV2640_D6_GPIO_PIN=36
CONFIG_CAMERA_OV2640_D7_GPIO_PIN=19
CONFIG_CAMERA_OV2640_XCLK_GPIO_PIN=27
CONFIG_CAMERA_OV2640_PCLK_GPIO_PIN=25
CONFIG_CAMERA_OV2640_VSYNC_GPIO_PIN=26
CONFIG_CAMERA_OV2640_HREF_GPIO_PIN=33

# Enable Audio
CONFIG_AUDIO=y
CONFIG_AUDIO_ES8388=y
CONFIG_AUDIO_ES8388_I2C=y
CONFIG_AUDIO_ES8388_I2C_NAME="I2C_0"
CONFIG_AUDIO_ES8388_I2C_SCL_GPIO_PIN=22
CONFIG_AUDIO_ES8388_I2C_SDA_GPIO_PIN=21

# Enable Battery
CONFIG_BATTERY=y
CONFIG_BATTERY_ADC=y
CONFIG_BATTERY_ADC_NAME="ADC_0"
CONFIG_BATTERY_ADC_INPUT_PIN=39
```
